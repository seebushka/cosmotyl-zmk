## boards/shields/cosmotyl/Kconfig.shield
```kconfig
config SHIELD_COSMOTYL_LEFT
    def_bool $(shields_list_contains,cosmotyl_left)

config SHIELD_COSMOTYL_RIGHT
    def_bool $(shields_list_contains,cosmotyl_right)

config SHIELD_COSMOTYL_DONGLE
    def_bool $(shields_list_contains,cosmotyl_dongle)
```

## boards/shields/cosmotyl_encoder_pin_test/Kconfig.defconfig
```kconfig
if SHIELD_COSMOTYL_ENCODER_PIN_TEST

config ZMK_KEYBOARD_NAME
    default "Cosmotyl Enc Pin Test"

endif
```

## boards/shields/cosmotyl_encoder_pin_test/Kconfig.shield
```kconfig
config SHIELD_COSMOTYL_ENCODER_PIN_TEST
    def_bool $(shields_list_contains,cosmotyl_encoder_pin_test)
```

## boards/shields/cosmotyl_left_test/Kconfig.defconfig
```kconfig
if SHIELD_COSMOTYL_LEFT_TEST

config ZMK_KEYBOARD_NAME
    default "Cosmotyl L Test"

endif
```

## boards/shields/cosmotyl_left_test/Kconfig.shield
```kconfig
config SHIELD_COSMOTYL_LEFT_TEST
    def_bool $(shields_list_contains,cosmotyl_left_test)
```

## boards/shields/cosmotyl_right_test/Kconfig.defconfig
```kconfig
if SHIELD_COSMOTYL_RIGHT_TEST

config ZMK_KEYBOARD_NAME
    default "Cosmotyl R Test"

endif
```

## boards/shields/cosmotyl_right_test/Kconfig.shield
```kconfig
config SHIELD_COSMOTYL_RIGHT_TEST
    def_bool $(shields_list_contains,cosmotyl_right_test)
```
